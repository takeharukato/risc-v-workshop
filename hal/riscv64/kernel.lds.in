/* -*- mode: C; coding:utf-8 -*- */
/* ld script 
 * Copyright Takeharu KATO 2019 
 */

__KERN_VMA_BASE = __KERN_VMA_BASE__;
__KERN_BASE = 0x80000000;  /* qemu's -kernel jumps to 0x80000000 */
OUTPUT_ARCH( "riscv" )
ENTRY(_kernel_start)
SECTIONS
{
    . = __KERN_BASE;
    _kernel_start = .;
    .boot : {
        *(.boot.text)
        *(.boot.data)

	. = ALIGN(__PAGE_SIZE__ * __TSTACK_PAGES__);
	_bsp_stack_start = .; 
	bsp_stack = .;
	. += (__PAGE_SIZE__ * __TSTACK_PAGES__ * __CPUS_NR__);
	_bsp_stack_end = .;
    }
    . += __KERN_VMA_BASE;
    .text : AT(ADDR(.text) - __KERN_VMA_BASE) {
        *(.text .rela.text .stub .text.* .gnu.linkonce.t.*)
        _rodata_start = .;
        *(.rodata .rodata.* .gnu.linkonce.r.*)
        _rodata_end = .;
    }

    .data : AT(ADDR(.data) - __KERN_VMA_BASE) {
        _data_start = .;
        *(.data)
        _data_end = .;
    }

    . = ALIGN(__PAGE_SIZE__);
    .bss :  AT(ADDR(.bss) - __KERN_VMA_BASE) {
        __bss_start = .;

	. = ALIGN(__PAGE_SIZE__ * __ISTACK_PAGES__);
	_intr_stack_start = .; 
	intr_stack = .;
	. += (__PAGE_SIZE__ * __ISTACK_PAGES__ * __CPUS_NR__);
	_intr_stack_end = .;

        *(.bss)
	*(COMMON)
	. = ALIGN(__PAGE_SIZE__);
        __bss_end = .;
    }
    . = ALIGN(__PAGE_SIZE__);
    _edata = .;			/* End of data section */
    . = ALIGN(__PAGE_SIZE__);
    _payload_start = .;
    .payload : { *(.payload) }
    _payload_end = .;
    . = ALIGN(__PAGE_SIZE__);
    _end = .  - __KERN_VMA_BASE;
    _kernel_end = . - __KERN_VMA_BASE;
    _kheap_vaddr_start = .;
    . += (__KHEAP_SIZE__);
    _kheap_vaddr_end = .;
    _kheap_end = . - __KERN_VMA_BASE;
    /DISCARD/ :
    {
	         *(.gcc_except_table)
                 *(.eh_frame)
                 *(.note)
                 *(.comment)
                 *(.rel.*)
                 *(.rela.*)
    }
}

