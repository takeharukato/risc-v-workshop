## configs/Config.in
```kconfig
#
# For a description of the syntax of this configuration file,
# see extra/config/Kconfig-language.txt
#

mainmenu "Kernel Configuration"

config CONFIG_SMP
	bool "SMP kernel"
	default n
	help
	  If you wish to build the kernel for multi-processor system, then answer Y here.

source "configs/hal/Config.in"

config CONFIG_CPUS_NR
       prompt "Max cpus"
       int
       default 1 if !CONFIG_SMP
       default 4 if CONFIG_SMP
       range 1 4

config CONFIG_UPPERHALF_KERNEL
    bool "Use Upper Half Kernel"
    default n if !CONFIG_RISCV64
    default y if CONFIG_RISCV64
    help
      Kernel virtual memory is placed onto upper half of virtual memory space.

config CONFIG_HEAP_SIZE
	int "heap memory size(UNIT:MB)"
	default 4
	range 1 768
	help
	  This sets the value of kernel heap memory size

config CONFIG_KSTACK_PAGE_ORDER
	int "Kernel stack pages(UNIT: page order)"
	default 1
	range 1 4
	help
	  This sets the value of default kernel stack size

config CONFIG_ISTACK_PAGE_ORDER
	int "Interrupt stack pages(UNIT: page order)"
	default 1
	range 1 4
	help
	  This sets the value of interrupt stack size

config CONFIG_THR_MAX
       int "The number of threads (UNIT: threads)"
       default 1024
       range 256 4096
       help
	  This sets the value of the timer slice for each thread in the round robin scheduling class by tick counts.

config CONFIG_TIMER_TIME_SLICE
       int "Timer slice of threads (UNIT: ticks)"
       default 10
       help
	  This sets the value of the timer slice for each thread in the round robin scheduling class by tick counts.

config CONFIG_PROFILE
    bool "Collect function call coverage"
    default n
    help
     collect profiling information
    depends on !CONFIG_HAL

config CONFIG_FORCE_UPDATE_GTAGS
    bool "Force update gtags"
    default n
    help
     Update gtag index forcefully
```

## configs/compile/Config.in
```kconfig
config CONFIG_GENERIC_OPT_FLAGS
       string "Generic optimization flags"
       default "-O0"

config CONFIG_GENERIC_DBG_FLAGS
       string "Generic debug flags"
       default "-ggdb3"

config CONFIG_GENERIC_WARN_FLAGS
       string "Generic Warning flags"
       default "-Wall -Werror"
```

## configs/riscv64/Config.in
```kconfig
config CONFIG_RISCV64
       bool
       default y

config CONFIG_HAL
	bool "Hardware Abstraction Layer(HAL)"
	default y if CONFIG_RISCV64
	help
	  If you wish to build the kernel for real hardware, then answer Y here.

config CONFIG_NR_IRQS
       int
       default 64

config CONFIG_HAL_PAGE_SIZE
       int
       default 4096

config CONFIG_HAL_PAGE_SHIFT
       int
       default 12

config CONFIG_HAL_STRAIGHT_PAGE_SIZE
       int
       default 0x200000

config CONFIG_HAL_KERN_VMA_BASE
       int     
       default 0xFFFFFFE000000000 if CONFIG_UPPERHALF_KERNEL
       default 0x0000000000000000 if !CONFIG_UPPERHALF_KERNEL

config CONFIG_HAL_MEMORY_SIZE_MB
       prompt "Max memory size(UNIT:MB)"
       int
       default 128
       range 16 1024

choice
    prompt "Timer Interval"
    default CONFIG_TIMER_INTERVAL_MS_10MS
    depends on CONFIG_HAL

config CONFIG_TIMER_INTERVAL_MS_1MS
    bool "1 milliseconds"
    help
      This sets timer tick as 1 milliseconds.

config CONFIG_TIMER_INTERVAL_MS_10MS
    bool "10 milliseconds"
    help
      This sets timer tick as 10 milliseconds.

config CONFIG_TIMER_INTERVAL_MS_100MS
    bool "100 milliseconds"
    help
      This sets timer tick as 100 milliseconds.

endchoice

config CONFIG_HAL_CFLAGS
       prompt "CFLAGS for Hardware Abstraction Layer"
       string
       default "-ffreestanding -fno-common -mno-relax -mcmodel=medany -fno-omit-frame-pointer -fno-stack-protector" 
       depends on CONFIG_HAL

config CONFIG_HAL_LDFLAGS
       string
       default "-nostdlib -Wl,-z,max-page-size=0x1000 -Wl,--build-id=none"
       depends on CONFIG_HAL

config CONFIG_HAL_OPT_FLAGS
       prompt "Additional optimize flags for HAL"
       string 
       default ""
       depends on CONFIG_HAL
```

## configs/uland/Config.in
```kconfig
config CONFIG_HAL_PAGE_SIZE
       int
       default 4096

config CONFIG_HAL_PAGE_SHIFT
       int
       default 12

config CONFIG_HAL_STRAIGHT_PAGE_SIZE
       int
       default 0x200000

config CONFIG_HAL_KERN_VMA_BASE
       int
       default 0xFFFFFFE000000000 if CONFIG_UPPERHALF_KERNEL
       default 0x0000000000000000 if !CONFIG_UPPERHALF_KERNEL

config CONFIG_HAL_MEMORY_SIZE_MB
       prompt "Max memory size(UNIT:MB)"
       int
       default 128
       range 128 1024

config CONFIG_HAL_CFLAGS
       string
       default "-ffreestanding -fno-common -fno-stack-protector"
choice
    prompt "Timer Interval"
    default CONFIG_TIMER_INTERVAL_MS_10MS

config CONFIG_TIMER_INTERVAL_MS_1MS
    bool "1 milliseconds"
    help
      This sets timer tick as 1 milliseconds.

config CONFIG_TIMER_INTERVAL_MS_10MS
    bool "10 milliseconds"
    help
      This sets timer tick as 10 milliseconds.

config CONFIG_TIMER_INTERVAL_MS_100MS
    bool "100 milliseconds"
    help
      This sets timer tick as 100 milliseconds.

endchoice

config CONFIG_HAL_LDFLAGS
       string
       default ""

config CONFIG_HAL_OPT_FLAGS
       prompt "Additional optimize flags for HAL"
       string
       default "-fno-omit-frame-pointer -mno-omit-leaf-frame-pointer"
```
